## main/Kconfig.projbuild
```kconfig
config LIB_BUILDER_FLASHMODE
    string
    default "qio" if ESPTOOLPY_FLASHMODE_QIO
    default "qout" if ESPTOOLPY_FLASHMODE_QOUT
    default "dio" if ESPTOOLPY_FLASHMODE_DIO
    default "dout" if ESPTOOLPY_FLASHMODE_DOUT
    default "opi" if ESPTOOLPY_FLASHMODE_OPI

config LIB_BUILDER_FLASHFREQ
    string
    default "120m" if ESPTOOLPY_FLASHFREQ_120M
    default "80m" if ESPTOOLPY_FLASHFREQ_80M
    default "64m" if ESPTOOLPY_FLASHFREQ_64M
    default "60m" if ESPTOOLPY_FLASHFREQ_60M
    default "40m" if ESPTOOLPY_FLASHFREQ_40M
    default "32m" if ESPTOOLPY_FLASHFREQ_32M
    default "30m" if ESPTOOLPY_FLASHFREQ_30M
    default "26m" if ESPTOOLPY_FLASHFREQ_26M
    default "20m" if ESPTOOLPY_FLASHFREQ_20M
    default "16m" if ESPTOOLPY_FLASHFREQ_16M

config LIB_BUILDER_COMPILE
    bool
    default y
```
